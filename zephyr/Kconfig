## zephyr/Kconfig
```kconfig
# Copyright (c) 2025 Ambiq
# SPDX-License-Identifier: Apache-2.0

config ZEPHYR_NS_CMSIS_NN_MODULE
	bool

menuconfig NS_CMSIS_NN
	bool "NS-CMSIS-NN Library Support"
	depends on CPU_CORTEX_M
	depends on !CMSIS_NN
	select CMSIS_DSP
	help
	  This option enables the NS-CMSIS-NN library.

if NS_CMSIS_NN

config NS_CMSIS_NN_ALL
	bool "Enable all NS-CMSIS-NN kernels"
	help
	  When enabled, all NS-CMSIS-NN kernel groups are turned on.

	# Safer than 'select': respects other symbols' dependencies,
	# and users can still turn individual groups off if they really want.
	imply NS_CMSIS_NN_ACTIVATION
	imply NS_CMSIS_NN_BASICMATHSNN
	imply NS_CMSIS_NN_COMPARISON
	imply NS_CMSIS_NN_CONCATENATION
	imply NS_CMSIS_NN_CONVOLUTION
	imply NS_CMSIS_NN_FULLYCONNECTED
	imply NS_CMSIS_NN_LSTM
	imply NS_CMSIS_NN_NNSUPPORT
	imply NS_CMSIS_NN_PAD
	imply NS_CMSIS_NN_POOLING
	imply NS_CMSIS_NN_QUANTIZATION
	imply NS_CMSIS_NN_RESHAPE
	imply NS_CMSIS_NN_SOFTMAX
	imply NS_CMSIS_NN_STRIDEDSLICE
	imply NS_CMSIS_NN_SVDF
	imply NS_CMSIS_NN_TRANSPOSE
	imply NS_CMSIS_NN_GATHER
	imply NS_CMSIS_NN_TILE
	imply NS_CMSIS_NN_BROADCAST
	imply NS_CMSIS_NN_SCATTER
	imply NS_CMSIS_NN_SELECT
	imply NS_CMSIS_NN_REVERSESEQUENCE
	imply NS_CMSIS_NN_DYNAMICUPDATESLICE

config NS_CMSIS_NN_ACTIVATION
	bool "Activation"
	imply NS_CMSIS_NN_NNSUPPORT
	help
	  This option enables the NN libraries for the activation layers
	  It can perform activation layers, including ReLU (Rectified
	  Linear Unit), sigmoid, and tanh.

config NS_CMSIS_NN_BASICMATHSNN
	bool "Basic Math for NN"
	imply NS_CMSIS_NN_NNSUPPORT
	help
	  This option enables the NN libraries for the basic maths operations.
	  It adds functionality for element-wise add and multiplication functions.

config NS_CMSIS_NN_COMPARISON
	bool "Comparison"
	imply NS_CMSIS_NN_NNSUPPORT
	help
	  Enables the NN comparison kernels (equal, not-equal, greater/less than,
	  with broadcast support) for int8 and int16 tensors.

config NS_CMSIS_NN_CONCATENATION
	bool "Concatenation"
	imply NS_CMSIS_NN_NNSUPPORT
	help
	  This option enables the NN libraries for the concatenation layers.

config NS_CMSIS_NN_CONVOLUTION
	bool "Convolution"
	imply NS_CMSIS_NN_NNSUPPORT
	help
	  Collection of convolution, depthwise convolution functions and
	  their variants. The convolution is implemented in 2 steps: im2col
	  and GEMM. GEMM is performed with CMSIS-DSP arm_mat_mult similar options.

config NS_CMSIS_NN_FULLYCONNECTED
	bool "Fully Connected"
	imply NS_CMSIS_NN_NNSUPPORT
	help
	  Collection of fully-connected and matrix multiplication functions.

config NS_CMSIS_NN_LSTM
	bool "Long Short-Term Memory"
	imply NS_CMSIS_NN_NNSUPPORT
	help
	  This option enables the NN libraries for Long Short-Term Memory.

config NS_CMSIS_NN_NNSUPPORT
	bool "NN Support"
	help
	  When off, its default behavior is all tables are included.

config NS_CMSIS_NN_PAD
	bool "Pad"
	imply NS_CMSIS_NN_NNSUPPORT
	help
	  This option enables the NN libraries for the pad layers.

config NS_CMSIS_NN_POOLING
	bool "Pooling"
	imply NS_CMSIS_NN_NNSUPPORT
	help
	  This option enables pooling layers, including max pooling,
	  and average pooling.

config NS_CMSIS_NN_QUANTIZATION
	bool "Quantization"
	imply NS_CMSIS_NN_NNSUPPORT
	help
	  This option enables quantization layers, including quantize
	  and dequantize.

config NS_CMSIS_NN_RESHAPE
	bool "Reshape"
	imply NS_CMSIS_NN_NNSUPPORT
	help
	  This option enables the NN libraries for the reshape layers.

config NS_CMSIS_NN_SOFTMAX
	bool "Softmax"
	imply NS_CMSIS_NN_NNSUPPORT
	help
	  This option enables the NN libraries for the softmax layers (exp2 based).

config NS_CMSIS_NN_STRIDEDSLICE
	bool "Strided Slice"
	imply NS_CMSIS_NN_NNSUPPORT
	help
	  This option enables the NN libraries for the strided slice layers.

config NS_CMSIS_NN_SVDF
	bool "SVDF"
	imply NS_CMSIS_NN_NNSUPPORT
	help
	  This option enables the NN libraries for Single Value Decomposition Filter layers.

config NS_CMSIS_NN_TRANSPOSE
	bool "Transpose"
	imply NS_CMSIS_NN_NNSUPPORT
	help
	  This option enables the NN libraries for the transpose layers.

config NS_CMSIS_NN_GATHER
	bool "Gather"
	imply NS_CMSIS_NN_NNSUPPORT
	help
	  This option enables the NN libraries for the gather layers.

config NS_CMSIS_NN_TILE
	bool "Tile"
	help
	  This option enables the NN libraries for the tile operator.

config NS_CMSIS_NN_BROADCAST
	bool "Broadcast"
	help
	  This option enables the NN libraries for the broadcast_to operator.

config NS_CMSIS_NN_SCATTER
	bool "Scatter"
	help
	  This option enables the NN libraries for the scatter_nd operator.

config NS_CMSIS_NN_SELECT
	bool "Select"
	help
	  This option enables the NN libraries for select_v2 and where operators.

config NS_CMSIS_NN_REVERSESEQUENCE
	bool "ReverseSequence"
	help
	  This option enables the NN libraries for the reverse_sequence operator.

config NS_CMSIS_NN_DYNAMICUPDATESLICE
	bool "DynamicUpdateSlice"
	help
	  This option enables the NN libraries for the dynamic_update_slice operator.

# ---- Deprecated aliases (from #160 rename) ----

config NS_CMSIS_NN_BASICMATH
	bool "Basic Math for NN [DEPRECATED]"
	select NS_CMSIS_NN_BASICMATHSNN
	select DEPRECATED
	help
	  Deprecated: use NS_CMSIS_NN_BASICMATHSNN instead.

config NS_CMSIS_NN_STRIDED_SLICE
	bool "Strided Slice [DEPRECATED]"
	select NS_CMSIS_NN_STRIDEDSLICE
	select DEPRECATED
	help
	  Deprecated: use NS_CMSIS_NN_STRIDEDSLICE instead.

config NS_CMSIS_NN_SVD
	bool "SVD [DEPRECATED]"
	select NS_CMSIS_NN_SVDF
	select DEPRECATED
	help
	  Deprecated: use NS_CMSIS_NN_SVDF instead.

endif #NS_CMSIS_NN
```
