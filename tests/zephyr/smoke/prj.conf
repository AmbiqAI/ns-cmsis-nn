## CMakeLists.txt
```
# SPDX-FileCopyrightText: Copyright 2024-2026 Ambiq <opensource@ambiq.com>
# SPDX-License-Identifier: Apache-2.0
#
# Minimal Zephyr smoke app for the ns-cmsis-nn module.
#
# Builds against an external Zephyr workspace (the CI workflow does the
# `west init`/`west update` and points west at the parent of this repo).
# The app links a single CMSIS-NN kernel and prints the version macro so
# any link- or include-path regression in the Zephyr integration fails the
# build instead of slipping through silently.

cmake_minimum_required(VERSION 3.20.0)

find_package(Zephyr REQUIRED HINTS $ENV{ZEPHYR_BASE})
project(ns_cmsis_nn_zephyr_smoke LANGUAGES C)

target_sources(app PRIVATE src/main.c)
```

## west.yml
```
# West manifest used by the Zephyr smoke CI job to pull Zephyr and add
# this repo as a module. The job clones ns-cmsis-nn into
# `workspace/ns-cmsis-nn` and runs `west init -l` against
# `workspace/ns-cmsis-nn/tests/zephyr/smoke` so this manifest is consumed.
manifest:
  remotes:
    - name: zephyrproject-rtos
      url-base: https://github.com/zephyrproject-rtos
  defaults:
    remote: zephyrproject-rtos
  self:
    path: ns-cmsis-nn
  projects:
    - name: zephyr
      revision: v3.7.0
      import:
        # Pull only the minimal set Zephyr needs to build a hello-world-
        # class app for QEMU Cortex-M; skip heavy/optional projects.
        name-allowlist:
          - cmsis
          - picolibc
          - segger
```

## prj.conf
```kconfig
# Smoke profile: enable ns-cmsis-nn with all kernel groups so the linker is
# forced to resolve every group's sources through the SSoT path.
CONFIG_NS_CMSIS_NN=y
CONFIG_NS_CMSIS_NN_ALL=y

# Tiny app footprint.
CONFIG_MAIN_STACK_SIZE=2048
CONFIG_PRINTK=y
```

## overlay-deprecated-aliases.conf
```kconfig
# Deprecated-alias smoke profile: drive the renamed Kconfig symbols via
# their pre-rename names. NS_CMSIS_NN_BASICMATH / STRIDED_SLICE / SVD are
# `select` aliases that pull in the new BASICMATHSNN / STRIDEDSLICE / SVDF
# symbols; if the alias glue breaks, this overlay's build will fail.
CONFIG_NS_CMSIS_NN=y
CONFIG_NS_CMSIS_NN_BASICMATH=y
CONFIG_NS_CMSIS_NN_STRIDED_SLICE=y
CONFIG_NS_CMSIS_NN_SVD=y
```

## overlay-inline-asm.conf
```kconfig
# Additional smoke profile: turn the inline-assembly requantize path on.
# Verifies that CONFIG_NS_CMSIS_NN_REQUANTIZE_INLINE_ASSEMBLY propagates
# as the CMSIS_NN_USE_REQUANTIZE_INLINE_ASSEMBLY compile definition.
CONFIG_NS_CMSIS_NN_REQUANTIZE_INLINE_ASSEMBLY=y
```

## src/main.c
```c
/*
 * SPDX-FileCopyrightText: Copyright 2024-2026 Ambiq <opensource@ambiq.com>
 *
 * SPDX-License-Identifier: Apache-2.0
 *
 * Minimal Zephyr smoke for the ns-cmsis-nn module.
 *
 * Goal: force the toolchain to actually resolve a CMSIS-NN symbol from
 * the ns-cmsis-nn module and emit a `west build` failure if the Zephyr
 * integration (`zephyr/CMakeLists.txt`, `zephyr/Kconfig`, the SSoT
 * include) breaks.
 *
 * The app does no real inference; it calls `arm_relu_q15` on a tiny
 * fixed buffer and prints the packed version macro.
 */

#include <stdint.h>

#include <zephyr/kernel.h>
#include <zephyr/sys/printk.h>

#include "arm_nn_types.h"
#include "arm_nnfunctions.h"

static int16_t smoke_buf[8] = { -3, -2, -1, 0, 1, 2, 3, 4 };

int main(void)
{
	arm_relu_q15(smoke_buf, ARRAY_SIZE(smoke_buf));

	printk("ns-cmsis-nn zephyr smoke OK, NS_CMSIS_NN_VERSION=%u, "
	       "buf[0]=%d buf[7]=%d\n",
	       (unsigned int)NS_CMSIS_NN_VERSION,
	       (int)smoke_buf[0], (int)smoke_buf[7]);

	return 0;
}
```
